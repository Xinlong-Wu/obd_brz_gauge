## main/Kconfig.projbuild
```kconfig
menu "OBD DSP Configuration"
    # Board abstraction: see main/bsp_obd_dsp/boards/board_api.h.
    # The WS185 hardware-version variants (V1/V2/V3) live one level below.

    config OBD_UI_RENDER_RES
        int "UI render resolution (square, master design is 720)"
        range 240 480
        default 360
        help
            Resolution the UI is rendered at. The layout/fonts/assets are
            authored against a 720x720 master and scaled to this value at
            compile time (UIS() in export_path/ui_res.h). Normally set to
            the panel's native resolution so no runtime scaling is needed
            (WS185=360, WS175=466, WS128=240). A value different from the
            panel resolution activates the ui_scale flush scaler at runtime
            (logged at boot).

    choice OBD_BOARD
        prompt "Display board"
        default OBD_BOARD_WS_185
        help
            Which physical board this firmware is built for. The selection
            dispatches main/bsp_obd_dsp/boards/ at compile time; see
            docs/DEVELOPMENT.md (适配新开发板).

        config OBD_BOARD_WS_185
            bool "WS185: Waveshare ESP32-S3-Touch-LCD-1.85 (360x360 IPS)"

        config OBD_BOARD_WS_175_AMOLED
            bool "WS175: Waveshare ESP32-S3-Touch-AMOLED-1.75 (466x466 AMOLED)"

        config OBD_BOARD_WS_128_GC9A01
            bool "WS128: Waveshare ESP32-S3-LCD-1.28 no-touch (240x240 IPS, GC9A01)"
            help
                Round 1.28" IPS board, 4-wire SPI GC9A01, ESP32-S3R2 (2MB Quad
                PSRAM — build with sdkconfig.defaults.ws128 overlay which also
                selects Quad PSRAM mode). No touch: display-only firmware.
                The UI renders at a virtual 360x360 and is downscaled to 240.
    endchoice

    config OBD_UI_RENDER_RES
        int "UI render resolution (square)"
        range 240 480
        default 360
        help
            Pixel resolution LVGL renders at. Layout/assets/fonts are authored
            at a 720 master and scaled to this value at compile time (UIS()
            in export_path/ui_res.h). Normally set to the panel's native
            resolution (360 WS185 / 466 WS175 / 240 WS128) so every board
            renders 1:1; note the 360-authored layout proportions hold, so
            resolutions above 360 render full-bleed only after the native-res
            migration (see docs/DEVELOPMENT.md resolution strategy).

    # Waveshare ESP32-S3-Touch-LCD-1.85
    # LCD: ST77916 (360x360 QSPI)
    # Touch: CST816 (I2C)
    # IO Expander: TCA9554PWR

    choice OBD_HW_VERSION
        prompt "OBD display hardware version"
        default OBD_HW_VERSION_V1_WAVESHARE
        help
            WS185 hardware variant (ignored when a non-WS185 board is selected —
            kept selectable everywhere so the ST77916 driver always compiles).
        help
            Select which display board this firmware is built for.
            The two new boards share the same pins (LCD QSPI + CST816 touch on
            their own I2C bus), but use different ST77916 init sequences and
            carry no TCA9554 IO expander / ADS1115 oil-pressure ADC.

        config OBD_HW_VERSION_V1_WAVESHARE
            bool "V1: Waveshare ESP32-S3-Touch-LCD-1.85 (ST77916 v2 init + TCA9554 + ADS1115)"

        config OBD_HW_VERSION_V2_NEW
            bool "V2: New board A (ST77916 v1 init, direct GPIO, no TCA9554/ADS1115)"

        config OBD_HW_VERSION_V3_NEW
            bool "V3: New board B (ST77916 v2 init, direct GPIO, no TCA9554/ADS1115)"
    endchoice

    config OBD_SCREENSHOT
        bool "WiFi screen capture (shadow framebuffer + MJPEG stream)"
        default y
        help
            Capture the rendered frame into a PSRAM shadow (flush hook) and
            serve it over WiFi: control page + MJPEG stream on :8080/:8081,
            started at boot (OBD_SCREENSHOT_AUTO_START) or available while
            the OTA-mode hotspot is up. PSRAM cost: res^2 * 2 bytes
            (115 KB @240, 259 KB @360, 434 KB @466).

    config OBD_SCREENSHOT_AUTO_START
        bool "Start the screen-capture server at boot (for no-touch boards)"
        depends on OBD_SCREENSHOT
        default n
        help
            Bring up the capture hotspot automatically after boot, without
            needing to navigate to the OTA page (impossible on touch-less
            boards like the WS128). The gauge keeps running normally
            (BLE OBD / ESP-NOW are not paused); enable in the board's
            sdkconfig.defaults overlay.

    config OBD_RS485_TX_GPIO
        int "RS485 TX GPIO"
        range 0 48
        default 13
        help
            UART TX pin used by the RS485 brake temperature module.
            Do not use GPIO43/44 on this board because they are typically tied to
            the onboard USB-UART bridge.

    config OBD_RS485_RX_GPIO
        int "RS485 RX GPIO"
        range 0 48
        default 12
        help
            UART RX pin used by the RS485 brake temperature module.

    config OBD_RS485_DE_RE_GPIO
        int "RS485 DE/RE GPIO (-1 disables direction control)"
        range -1 48
        default -1
        help
            Optional GPIO to control RS485 transceiver direction.
            Set HIGH when transmitting and LOW when receiving.
            Keep -1 if your USB/RS485 module handles direction automatically.
endmenu
```
